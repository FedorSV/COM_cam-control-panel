/* 
  Программа наземной станции для макета спутника.
  Сделана для Arduino Nano и NRF24L01
  Использует радиоканалы 0x60 и 0x70.
  Действие программы:
  Плата ардуино подключённая к компьютеру получает через Serial port различные числа - команды от программы на компьютере.
  Если число равно 0xFF, то программа отправляет эту же команду по радио на спутник. 0xFF - команда: сделать кадр.
  Если число равно 0xEE, то программа отправляет эту же команду по радио на спутник. 0xEE - команда: отправить кадр.
  Затем программа ждёт сообщения о начале кадра от спутника и сообщает об этом программу на компьютере командой 0xBB.
  Данная программа настроена на приём цветной картинки разрешением 160x120.
  Обручников Кирилл. 29.12.22.
*/

//---------------------------------------------БИБЛИОТЕКИ---------------------------------------------\\

#include <SPI.h>
#include "nRF24L01.h"
#include "RF24.h"

//---------------------------------------------РАДИО---------------------------------------------\\

RF24 radio(9, 10);//(CE, CSN)
uint64_t writingPipe = 0xff7f7f7f7f, readingPipe = 0xff6f6f6f6f;//адреса труб для чтения и отправки данных
byte readingChannel = 0x60, writingChannel = 0x70;//номера каналов приёма и передачи данных в 16 системе счисления
//программа использует разные каналы для приёма и для передачи. Так рекомендуют делать на различных ресурсах.
//скорее всего, это необходимо для того, чтобы не прочитать собственное сообщение или для служебных сообщений.
byte command = 0;// буфер входящего числа от компьютера.
byte input = 0;// буфер входящего числа от спутника.
const byte commandCaptureImage = 0xFF;
const byte commandTransmitImage = 0xEE;
const byte commandImageStart = 0xBB;

void radioSettings(void)//функция быстрой настройки радио вызывается в setup
{
  radio.begin();
  delay(2000);
  radio.setAutoAck(1);
  radio.setRetries(0, 15);
  radio.enableAckPayload();
  radio.setPayloadSize(32);

  radio.openReadingPipe(1, readingPipe);//открытие трубы для чтения сообщений
  radio.openWritingPipe(writingPipe);//открытие трубы для отправки сообщений

  radio.setPALevel (RF24_PA_MAX);
  radio.setDataRate (RF24_2MBPS);// установлена максимальная скорость передачи данных в 2 мегабита в секунду.

  radio.powerUp();
  delay(100);// небольшая задержка для того, чтобы модуль успел запуститься.
}

void toRX (void)//функция, переключающаа радиомодуль в режим приёма данных.
{
  delay(100);
  radio.setChannel(readingChannel);
  radio.startListening();
  delay(100);
}

void toTX (void)//функция, переключающаа радиомодуль в режим отправки данных.
{
  delay(100);
  radio.setChannel(writingChannel);
  radio.stopListening();
  delay(100);
}

void transmitByte(byte *transmitAddr)// функция пытается отправить байт данных. принимает указатель на байт.
{
  while(!radio.write(transmitAddr), 1){;}//этот цикл постоянно вызывает метод radio.write для очередной попытки отправки
  //метод radio.write() принимает адрес переменной, которую нужно отправить, а возвращает результат отправки (успешно или нет).
  //также метод принимает объём данных для отправки в байтах. В этом случае это всегда 1 байт.
  //цикл кончится только тогда, когда сообщение успешно дойдёт.
}

void waitForRecive(byte *reciveAddr)//функция, ожидающаяя сообщений по радио и записывающаяя их. принимает адрес запси.
{
  while(!radio.available()){;}//цикл, ожидающий сообщений по радио
  radio.read(reciveAddr, 1);//записать в переменную по принятому адресу сообщение. вес сообщения всегда 1 байт
}

//---------------------------------------------ПОСЛЕДОВАТЕЛЬНЫЙ_ПОРТ---------------------------------------------\\
const uint64_t baud = 9600;// значение скорости общения с компьютером. может быть и больше.

byte waitForSerialCommand(void)//функция, ожидающая команд от компьютера
{
  while(Serial.available() == 0){;}
  return(Serial.parseInt());//Serial.read вернёт входящий байт. Serial.parseInt вернёт число введённое символами.
}

void commandDone(void)//функция, сообщающая компьютеру, что какая-то команда была выполнена.
{
  Serial.write(0xAA);
}

//---------------------------------------------ГЛАВНЫЙ_РАЗДЕЛ---------------------------------------------\\

void setup()//настройки перед началом работы
{
  Serial.begin(9600);
  radioSettings();
}

void loop()//основной цикл программы
{
  command = waitForSerialCommand();// в начале цикла программа ожидает команды от компьютера и записывает её.
  delay(100);
  
  if(command == commandCaptureImage)//если команда: сделать кадр
  {
    toTX();// В режим отправки
    
    transmitByte(&command);// отправить команду
    delay(100);
    
    toRX();//в режим приёма
    
    waitForRecive(&input);// ждать подтверждения окончания записи кадра
    
    if(input == 0xAA)
    {
      commandDone();// сообщить компьютеру о завершении записи кадра.
    }
  }

  if(command == commandTransmitImage)
  {
    toTX();// в режим отправки
    
    transmitByte(&command);// отправить команду
    delay(100);

    toRX();// в режим приёма
    
    waitForRecive(&input)// ждать сообщения о начале кадра
    
    if(input == commandImageStart)
    {
      Serial.write(input);//сообщить компьютеру о начале кадра
      
      for(uint16_t i = 0; i < 38400; i++)//цикл приёма кадра. 38400 - вес кадра в байтах (160 * 120 * 2) площадь кадра в пикселях. 2 байта на пиксель
      {
        byte buf = 0;
        waitForRecive(&buf)
        Serial.write(buf);
      }
    }
    
    waitForRecive(&input)// ожидать команды об окончании кадра.
    
    if(command == 0xAA)
    {
      commandDone();// сообщить компьютеру об окончании кадра.
    }
  }
}
